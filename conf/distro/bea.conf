## conf/distro/bea.conf
```bitbake
require conf/distro/poky.conf

DISTRO = "bea"
DISTRO_NAME = "beadistro - a testing distro"
DISTRO_VERSION = "1.0.0"
DISTRO_CODENAME = "Crazy Time"

DISTRO_FEATURES:append = " systemd pam"
VIRTUAL-RUNTIME_init_manager = "systemd"

DISTRO_FEATURES_BACKFILL_CONSIDERED = "sysvinit"

VIRTUAL-RUNTIME_initscripts = ""
```

## conf/layer.conf
```bitbake
# We have a conf and classes directory, add to BBPATH
BBPATH .= ":${LAYERDIR}"

# We have recipes-* directories, add to BBFILES
BBFILES += "${LAYERDIR}/recipes-*/*/*.bb \
            ${LAYERDIR}/recipes-*/*/*.bbappend"

BBFILE_COLLECTIONS += "meta-bea"
BBFILE_PATTERN_meta-bea = "^${LAYERDIR}/"
BBFILE_PRIORITY_meta-bea = "6"

LAYERDEPENDS_meta-bea = "core"
LAYERSERIES_COMPAT_meta-bea = "dunfell kirkstone"
```

## conf/machine/bea-container.conf
```bitbake
#@TYPE: Machine
#@NAME: Container x86_64
#@DESCRIPTION: Machine configuration for generic x86_64 (64-bit) containers

require conf/machine/qemux86-64.conf

PREFERRED_PROVIDER_virtual/kernel ?= "linux-dummy"

MACHINE_ESSENTIAL_EXTRA_RDEPENDS = ""

IMAGE_FSTYPE = "container"
```

## conf/machine/bea.conf
```bitbake
#@TYPE: Machine
#@NAME: BeagleBone machine
#@DESCRIPTION: Machine configuration for the http://beagleboard.org/bone board

require conf/machine/include/ti-soc.inc
SOC_FAMILY:append = ":ti33x"

DEFAULTTUNE ?= "armv7athf-neon"
require conf/machine/include/arm/armv7a/tune-cortexa8.inc

# Increase this everytime you change something in the kernal

require conf/machine/include/bea.inc

KERNEL_DEVICETREE = "am335x-boneblack.dtb"

MACHINE_GUI_CLASS = "bigscreen"

MACHINE_FEATURES += "screen"

SERIAL_CONSOLES = "115200;ttyS0"

MACHINE_ESSENTIAL_EXTRA_RDEPENDS += "kernel-devicetree kernel-image-zimage"

UBOOT_ARCH = "arm"
UBOOT_MACHINE = "am335x_evm_config"
UBOOT_ENTRYPOINT = "0x80008000"
UBOOT_LOADADDRESS = "0x80008000"

SPL_BINARY = "MLO"
UBOOT_SUFFIX = "img"

# Use the expected value of the ubifs filesystem's volume name in the kernel
# and u-boot.
UBI_VOLNAME = "rootfs"

EXTRA_IMAGEDEPENDS += "virtual/bootloader"

# List common SoC features, may need to add touch screen for specific machines
MACHINE_FEATURES = "kernel26 apm usbgadget usbhost vfat ext2 alsa ethernet gpu"

IMAGE_FSTYPES += "tar.xz wic.xz wic.bmap"
WKS_FILE ?= "sdimage-2part.wks"
IMAGE_BOOT_FILES ?= "${SPL_BINARY} u-boot.${UBOOT_SUFFIX}"
do_image_wic[depends] += "virtual/bootloader:do_deploy"
```

## conf/machine/include/bea.inc
```bitbake
# Define preferred providers

# Kernel
PREFERRED_PROVIDER_virtual/kernel ?= "linux-ti-staging"

# Uboot
PREFERRED_PROVIDER_virtual/bootloader ?= "u-boot-ti-staging"
PREFERRED_PROVIDER_u-boot ?= "u-boot-ti-staging"
PREFERRED_PROVIDER_virtual/egl ?= "ti-sgx-ddk-um"
PREFERRED_PROVIDER_virtual/libgles1 ?= "ti-sgx-ddk-um"
PREFERRED_PROVIDER_virtual/libgles2 ?= "ti-sgx-ddk-um"
PREFERRED_PROVIDER_virtual/libgbm ?= "ti-sgx-ddk-um"
PREFERRED_PROVIDER_virtual/gpudriver ?= "ti-sgx-ddk-km"
```
